// SPDX-License-Identifier: GPL-2.0+
/*
 * Support for Variscite VAR-SOM-6UL Module with 6ULL CPU variant.
 *
 * Copyright 2019-2024 Variscite Ltd.
 * Copyright 2026 Dimonoff
 */

#include "imx6ull.dtsi"
#include "imx6ul-var-som-common.dtsi"

/ {
	model = "Variscite VAR-SOM-6UL module (6ULL CPU)";
	compatible = "variscite,var-som-imx6ull", "fsl,imx6ull";
};
