// SPDX-License-Identifier: GPL-2.0+
/*
 * Support for Variscite VAR-SOM-6UL Module with 6UL CPU variant
 *
 * Copyright 2019 Variscite Ltd.
 * Copyright 2025 Bootlin
 */

/dts-v1/;

#include "imx6ul.dtsi"
#include "imx6ul-var-som-common.dtsi"

/ {
	model = "Variscite VAR-SOM-6UL module (6UL CPU)";
	compatible = "variscite,var-som-imx6ul", "fsl,imx6ul";
};
